## tab5/main/Kconfig.projbuild
```kconfig
menu "TAB5 DXFT8 bring-up"

config DXFT8_PA_TEST
    bool "Manual 40 m populated-PA bench console (disarmed boot)"
    depends on DXFT8_REAL_RF_BOARD
    default n
    help
        Bypasses all automatic bring-up and leakage-loopback startup.
        G48 LOW and G47 LOW at boot. USB commands manually arm one bounded
        100/250 ms burst at 7.075 MHz. Separate optional leakage command
        enables CLK1 but never switches G47 HIGH. No LPF/load/current sensing:
        operator must fit a 40 m LPF and rated 50-ohm dummy load, no antenna.
        Software cutoff is not a hardware RF interlock or protection guarantee.

config DXFT8_REAL_RF_BOARD
    bool "Power the real RF daughter board (G48) and hold RX selected (G47)"
    default n
    help
        Barb's September 2026 assembly notes define G48 high as RF power on
        and G47 high as RX selected / TX off. The mock does not use these pins.
        This is bench bring-up, not a complete transmitter or LPF interlock.

config DXFT8_SCOPE_CLK0_CARRIER
    bool "Leave CLK0 at 14.075 MHz after successful checks (BS170s absent only)"
    depends on DXFT8_REAL_RF_BOARD
    depends on !DXFT8_PA_TEST
    depends on !DXFT8_I2S_CONTINUOUS_DIAGNOSTIC
    default n
    help
        Explicit scope-only mode: requires the BS170s to remain uninstalled.
        Keeps G47 high, disables CLK1/CLK2, and leaves CLK0 running until power
        is removed. It intentionally does not perform LPF sensing or enable TX.
        Never use this build with a populated PA. It restarts on every boot.

config DXFT8_TAB5_I2C_SDA_GPIO
    int "I2C SDA GPIO (M5-Bus default)"
    range 0 63
    default 31

config DXFT8_TAB5_I2C_SCL_GPIO
    int "I2C SCL GPIO (M5-Bus default)"
    range 0 63
    default 32

config DXFT8_TAB5_I2C_FREQUENCY_HZ
    int "I2C clock frequency (Hz)"
    range 10000 400000
    default 100000

config DXFT8_TAB5_I2C_INTERNAL_PULLUPS
    bool "Enable ESP32-P4 internal I2C pull-ups"
    default n
    help
        The Tab5 internal bus on GPIO31/GPIO32 already has external pull-ups.
        Enable for short Port A jumpers if using GPIO53/GPIO54 without
        external pull-ups.

config DXFT8_SI5351_ADDRESS
    hex "Si5351 7-bit I2C address"
    range 0x08 0x77
    default 0x60

config DXFT8_SI5351_REFERENCE_HZ
    int "Si5351 reference frequency (Hz)"
    range 10000000 40000000
    default 26000000
    help
        Barb's RF-board v1.3 uses a 26 MHz active oscillator coupled into XA.
        This remains configurable for development modules with another
        reference frequency.

choice DXFT8_SI5351_REFERENCE_MODE
    prompt "Si5351 XA reference mode"
    default DXFT8_SI5351_EXTERNAL_REFERENCE
    help
        Select the input type and internal load capacitance for register 183.
        The RF-board schematic uses an AC-coupled external oscillator, which
        requires the 0 pF setting. Passive-crystal modules must match their
        crystal's specified load capacitance.

config DXFT8_SI5351_EXTERNAL_REFERENCE
    bool "External clock on XA (0 pF; RF-board v1.3)"

config DXFT8_SI5351_CRYSTAL_6PF
    bool "Passive crystal, 6 pF"

config DXFT8_SI5351_CRYSTAL_8PF
    bool "Passive crystal, 8 pF"

config DXFT8_SI5351_CRYSTAL_10PF
    bool "Passive crystal, 10 pF"

endchoice

config DXFT8_RUN_TX_PATH_SELF_TEST
    bool "Briefly exercise the TX clock-enable mask"
    depends on !DXFT8_REAL_RF_BOARD
    default n
    help
        Enables CLK0 briefly while keeping CLK1/QSD running to test the mock's
        clock-enable masks. This is not the real board's transmit sequence:
        G47 selects RX/TX, while G48 controls the main RF power switch.
        Enable this only for the RF-board mock acceptance test.  It must stay
        disabled when a powered PA or antenna is connected.

menu "PCM1808 I2S validation"

config DXFT8_RUN_I2S_SELF_TEST
    bool "Run the I2S validation after the Si5351 test"
    default y
    depends on !DXFT8_PA_TEST
    help
        Starts the ESP32-P4 as I2S master RX on the RF-card M5-Bus pins.
        Disable this to retain an I2C-only test when the I2S wires are absent.

config DXFT8_TAB5_I2S_MCLK_GPIO
    int "MCLK/SCKI output GPIO"
    depends on DXFT8_RUN_I2S_SELF_TEST
    range 0 63
    default 16

config DXFT8_TAB5_I2S_BCLK_GPIO
    int "BCLK output GPIO"
    depends on DXFT8_RUN_I2S_SELF_TEST
    range 0 63
    default 45

config DXFT8_TAB5_I2S_LRCK_GPIO
    int "LRCK/WS output GPIO"
    depends on DXFT8_RUN_I2S_SELF_TEST
    range 0 63
    default 3

config DXFT8_TAB5_I2S_DIN_GPIO
    int "ADC DOUT / Tab5 DIN GPIO"
    depends on DXFT8_RUN_I2S_SELF_TEST
    range 0 63
    default 4

config DXFT8_TAB5_I2S_SAMPLE_RATE_HZ
    int "I2S sample rate (Hz)"
    depends on DXFT8_RUN_I2S_SELF_TEST
    range 8000 96000
    default 48000
    help
        Production default: Fs=48 kHz, MCLK=256fs (12.288 MHz), stereo
        32-bit slots and 64 BCLK per frame (3.072 MHz BCLK).

choice DXFT8_I2S_TEST_MODE
    prompt "I2S validation mode"
    depends on DXFT8_RUN_I2S_SELF_TEST
    default DXFT8_I2S_CAPTURE_STATS if DXFT8_REAL_RF_BOARD
    default DXFT8_I2S_MOCK_PATTERN_TEST
    help
        Select the deterministic YD-board test for bench wiring, or ordinary
        sample statistics for the eventual real PCM1808. The mock-pattern
        test is expected to fail when connected to real audio.

config DXFT8_I2S_MOCK_PATTERN_TEST
    bool "Validate the YD-board mock pattern"
    depends on !DXFT8_REAL_RF_BOARD

config DXFT8_I2S_CAPTURE_STATS
    bool "Capture and summarize real PCM1808 samples"

config DXFT8_I2S_CONTINUOUS_DIAGNOSTIC
    bool "Continuous real-board I2S scope diagnostic (keeps clocks/power on)"
    depends on DXFT8_REAL_RF_BOARD
    help
        Continuously receive the PCM1808 while keeping G48 high and G47 high.
        By default all Si5351 outputs are off; the QSD comparison option below
        retains CLK1 only. Discard the configured startup interval, then log
        raw samples and one-second statistics. Flat samples and padding errors
        are reported without switching off the clocks needed for probing.
        Actual I2S API/read errors remain fatal. Bench use only with BS170s
        absent; reset or remove power to stop. This is not an ADC pass/fail test.

endchoice

config DXFT8_I2S_DIAGNOSTIC_RX_CLOCK
    bool "Keep CLK1/QSD enabled during continuous I2S diagnostic"
    depends on DXFT8_I2S_CONTINUOUS_DIAGNOSTIC
    default n
    help
        Controlled comparison against the all-RF-clocks-off diagnostic. Keep
        the original RX test clock CLK1=28.296 MHz enabled; CLK0 stays disabled.
        The startup discard is selected independently below; I2S settings
        are unchanged.

config DXFT8_I2S_DIAGNOSTIC_STARTUP_MS
    int "Continuous diagnostic startup discard (milliseconds)"
    depends on DXFT8_I2S_CONTINUOUS_DIAGNOSTIC
    range 0 5000
    default 1000
    help
        Comparison 1 used 1000 ms. Comparison 2 uses 250 ms with the same
        CLK1/QSD and I2S settings. This controls discarded sample frames,
        not a sleep: clocks run and RX is drained throughout the interval.

config DXFT8_RX_LOOPBACK_BENCH
    bool "BS170-absent RX leakage loopback: CLK0 source + CLK1 QSD"
    depends on DXFT8_I2S_CONTINUOUS_DIAGNOSTIC
    depends on DXFT8_I2S_DIAGNOSTIC_RX_CLOCK
    default n
    help
        Bench only with every BS170 PA transistor absent. Holds G47 HIGH
        (RX selected), G48 HIGH, CLK1 at 28.296 MHz, and I2S at 48 kHz.
        Measures CLK0 off, 7.075 MHz on, off, 7.076 MHz on, then 7.075 MHz
        on again. Expected beat tones are 1 and 2 kHz. Discards one second
        before each one-second measurement and finally leaves the 1 kHz
        source running with continuous I2S diagnostics for scope probing.
        This deliberately bypasses normal mutually-exclusive RX/TX clock
        operation. No LPF/TX interlock exists. Never fit BS170s or attach
        an antenna with this firmware installed; power off first and
        replace it before proceeding to a populated-PA test.

config DXFT8_I2S_TEST_FRAMES
    int "Frames to validate/capture"
    depends on DXFT8_RUN_I2S_SELF_TEST
    range 480 480000
    default 4800
    help
        At 48 kHz, 4800 frames represents 100 ms. The deterministic pattern
        test checks every frame for channel order, alignment and continuity.

endmenu

endmenu
```
